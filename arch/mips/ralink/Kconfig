## vendors/Kconfig.mt7628
```kconfig
menu "mt7628 Wi-Fi driver"

choice 
       prompt "Wi-Fi mode"
       config MT_AP_SUPPORT
       bool "AP"

       config MT_STA_SUPPORT
       bool "STA"

endchoice

config NEW_RATE_ADAPT_SUPPORT
       bool "New adaption rate"
       default n

config AGS_SUPPORT
       bool "AGS support"
       default n
       depends on NEW_RATE_ADAPT_SUPPORT

config RLT_MAC
       bool "RLT MAC"
       default n

config RTMP_MAC
       bool "RTMP MAC"
       default n

config MT_MAC
       bool "MT MAC"
       default n

config UAPSD
       bool "Unscheduled Automatic Power Save Delivery"
       default n

config WSC_INCLUDED
       bool "WSC"
       default n

config WSC_V2_SUPPORT
       bool "WSC V2"
       depends on WSC_INCLUDED
       default n

config DOT11_VHT_AC
       bool "AC support"
       default n

config WMM_ACM_SUPPORT
       bool "WMM ACM"
       default n

config DOT11W_PMF_SUPPORT
       bool "802.11w PMF support"
       default n

config LLTD_SUPPORT
       bool "Link Layer Topology Discovery"
       default n

config PASSPOINT_R2
       bool "Pass point R2"
       default n

config SNIFFER_SUPPORT
       bool "Sniffer support"
       default n

config IGMP_SNOOP_SUPPORT
       bool "IGMP snooping"
       default n

config BLOCK_NET_IF
       bool "Block net iface"
       default n

config SINGLE_SKU
       bool "Single SKU V2"
       default n

config LED_CONTROL_SUPPORT
       bool "LED Control"
       default n

config QOS_DLS_SUPPORT
       bool "QoS DLS"
       default n

config MBSS_SUPPORT
       bool "MBSS support"
       default n

config NEW_MBSSID_MODE
       bool "New MBSSID mode"
       default n
       depends on MBSS_SUPPORT

config ENHANCE_NEW_MBSSID_MODE
       bool "Enchance new MBSSID mode"
       default n
       depends on NEW_MBSSID_MODE

config APCLI_SUPPORT
       bool "ApCli support"
       default n

config MAC_REPEATER_SUPPORT
       bool "MAC repeater support"
       default n
       depends on APCLI_SUPPORT

config IDS_SUPPORT
       bool "Intrusion Detection System"
       default n

config ATE_SUPPORT
       bool "ATE support"
       default n

#config RTMP_FLASH_SUPPORT
#       bool "RTMP Flash support"
#       default n

config RTMP_TEMPERATURE_TX_ALC
       bool "Temperature Tx ALC"
       default n

config TXBF_SUPPORT
       bool "Tx buffer support"
       default n

config DFS_SUPPORT
       bool "Dynamic Frequency Selection 802.11h"
       default n

config BAND_STEERING
       bool "Band steering"
       default n

config RTMP_INTERNAL_TX_ALC
       bool "Internal Tx ALC"
       default n
endmenu
```

## vendors/Kconfig.ralink
```kconfig
menu "Ralink Module"


config  RALINK_HWCRYPTO
	depends on RALINK_MT7621
	tristate "HW Crypto Engine"
	default n

#############
# Wireless
#############
menuconfig RT2860V2_AP
	bool "RT2860v2 Wi-Fi Driver"
	select WIRELESS_EXT
	select WEXT_SPY
	select WEXT_PRIV

if RT2860V2_AP
source "drivers/net/wireless/rt2860v2_ap/Kconfig"
endif

menuconfig RT539X_AP
	bool "RT539X PCI Wi-Fi Driver"
	select WIRELESS_EXT
	select WEXT_SPY
	select WEXT_PRIV
	

if RT539X_AP
source "drivers/net/wireless/rt5392_ap/Kconfig"
endif

menuconfig RT359X_AP
	bool "RT359X PCI Wi-Fi Driver"
	select WIRELESS_EXT
	select WEXT_SPY
	select WEXT_PRIV
	

if RT359X_AP
source "drivers/net/wireless/rt3592_ap/Kconfig"
endif

menuconfig RT559X_AP
	bool "RT559X PCI Wi-Fi Driver"
	select WIRELESS_EXT
	select WEXT_SPY
	select WEXT_PRIV

if RT559X_AP
source "drivers/net/wireless/rt5592_ap/Kconfig"
endif

#######
# USB
#######
config DWC_OTG
        depends on RALINK_RT3052
        tristate "Ralink DWC_OTG support"
        ---help---
          This driver supports Ralink DWC_OTG

choice
        prompt "USB Operation Mode"
        depends on DWC_OTG
        default DWC_OTG_HOST_ONLY

config DWC_OTG_HOST_ONLY
        bool "HOST ONLY MODE"
        depends on DWC_OTG

config DWC_OTG_DEVICE_ONLY
        bool "DEVICE ONLY MODE"
        depends on DWC_OTG

endchoice


config DWC_OTG_DEBUG
        bool "Enable debug mode"
        depends on DWC_OTG

endmenu
```

## vendors/Kconfig.wifi
```kconfig
menu "MTK module (MT7602E && MT7612E)"

menuconfig WIFI_DRIVER
	bool "Wi-Fi driver support"

if WIFI_DRIVER

choice
	prompt "Choose first Wi-Fi interface"

	config FIRST_IF_RT2860
	bool "RT2860 (MT7602E)"
	select RTMP_MAC
	select RALINK_RT2860
endchoice

choice
	prompt "EEPROM type of 1st card"
	depends on ! FIRST_IF_NONE

	config FIRST_IF_EEPROM_PROM
	bool "EEPROM"

	config FIRST_IF_EEPROM_EFUSE
	bool "EFUSE"

	config FIRST_IF_EEPROM_FLASH
	bool "FLASH"
endchoice

choice
	prompt "Choose second Wi-Fi interface"

	config SECOND_IF_MT7612E
	bool "MT7612E"
	select RLT_MAC
	select RALINK_MT7612E
endchoice

choice
	prompt "EEPROM type of 2nd card"
	depends on ! SECOND_IF_NONE

	config SECOND_IF_EEPROM_PROM
	bool "EEPROM"

	config SECOND_IF_EEPROM_EFUSE
	bool "EFUSE"

	config SECOND_IF_EEPROM_FLASH
	bool "FLASH"
endchoice

config RT_FIRST_CARD
	int
	depends on ! FIRST_IF_NONE
	default 2860 if FIRST_IF_RT2860

config RT_SECOND_CARD
	int
	depends on ! SECOND_IF_NONE
	default 7612 if SECOND_IF_MT7612E

config RT_FIRST_IF_RF_OFFSET
	hex
	depends on ! FIRST_IF_NONE
	default 0x40000

config RT_SECOND_IF_RF_OFFSET
	hex
	depends on ! SECOND_IF_NONE
	default 0x48000

config RT_FIRST_CARD_EEPROM
	string
	depends on ! FIRST_IF_NONE
	default "prom" if FIRST_IF_EEPROM_PROM
	default "efuse" if FIRST_IF_EEPROM_EFUSE
	default "flash" if FIRST_IF_EEPROM_FLASH

config RT_SECOND_CARD_EEPROM
	string
	depends on ! SECOND_IF_NONE
	default "prom" if SECOND_IF_EEPROM_PROM
	default "efuse" if SECOND_IF_EEPROM_EFUSE
	default "flash" if SECOND_IF_EEPROM_FLASH

config MULTI_INF_SUPPORT
	bool
	default y if !FIRST_IF_NONE && !SECOND_IF_NONE

config PCI_SUPPORT
	bool

choice
	prompt "Configuration method selection"
	default CONFIG_METHOD_NEW

	config CONFIG_METHOD_NEW
	bool "New"
	select WIFI_BASIC_FUNC
endchoice

if CONFIG_METHOD_NEW
	menu "Wi-Fi generic feature options"
		source "drivers/net/wireless/mt76x2/Kconfig"
	endmenu

	menu "Wi-Fi operation modes"
		choice
			prompt "Main mode"
			default WIFI_MODE_AP

			config WIFI_MODE_AP
			bool "AP"
		endchoice

		if WIFI_MODE_AP
		source "drivers/net/wireless/mt76x2_ap/Kconfig"
		endif
	endmenu

	config RALINK_RT28XX
		bool
		default n
		select RTMP_PCI_SUPPORT

	config RALINK_MT7612E
		bool
		default n
		select RTMP_PCI_SUPPORT
endif # CONFIG_METHOD_NEW

endif # WIFI_DRIVER

config RTDEV
	bool
	default y if WIFI_DRIVER && !SECOND_IF_NONE || RTDEV_MII
	default y if RTDEV_PLC
endmenu
```
