## arch/mips/ralink/Kconfig
```kconfig
if RALINK_RT2880

choice
        prompt "Soc Hardware Type"
	default RT2880_ASIC

config  RT2880_ASIC 
        bool "RT2880-ASIC"
endchoice

endif
#-----------------------------

if RALINK_RT2883

choice
        prompt "Soc Hardware Type"
	default RT2883_ASIC

config  RT2883_ASIC 
        bool "RT2883-ASIC"
endchoice

endif

#---------------------------

if RALINK_RT3052

choice
        prompt "Soc Hardware Type"
	default RT3052_ASIC

config  RT3052_ASIC 
        bool "RT305x/RT3350-ASIC"
endchoice

config RALINK_RT3350
	bool "Ralink RT3350 chipset"

endif

#---------------------------

if RALINK_RT3352

choice
        prompt "Soc Hardware Type"
	default RT3352_ASIC

config  RT3352_ASIC 
	bool "RT3352-ASIC"
	select USB_ARCH_HAS_OHCI
	select USB_ARCH_HAS_EHCI

endchoice

endif

#--------------------------

if RALINK_RT3883

choice
        prompt "Soc Hardware Type"
	default RT3883_ASIC

config  RT3883_ASIC 
	bool "RT3883/RT3662-ASIC"
	select USB_ARCH_HAS_OHCI
	select USB_ARCH_HAS_EHCI
endchoice

choice
        prompt "RT3883 PCI architecture"
	default PCIE_PCI_CONCURRENT

config PCIE_PCI_CONCURRENT
        bool "PCIE RC and PCI HOST CONCURRENT"
	select PCI
config PCIE_ONLY
        bool "PCIE RC ONLY"
	select PCI
config PCI_ONLY
        bool "PCI HOST ONLY"
	select PCI
config PCIE_PCI_NONE
        bool "Non-support PCI/PCIe"
endchoice

endif

#---------------------------

if RALINK_RT5350

choice
	prompt "Soc Hardware Type"
	default RT5350_ASIC

config	RT5350_ASIC 
	bool "RT5350-ASIC"
	select USB_ARCH_HAS_OHCI
	select USB_ARCH_HAS_EHCI

endchoice

endif

#--------------------------

if RALINK_RT6855

choice
        prompt "Soc Hardware Type"
	default RT6855_ASIC

config  RT6855_ASIC 
	bool "RT6855-ASIC"
	select USB_ARCH_HAS_OHCI
	select USB_ARCH_HAS_EHCI

endchoice

endif

#--------------------------

if RALINK_MT7620

choice
        prompt "Soc Hardware Type"
	default MT7620_ASIC

config  MT7620_ASIC 
	bool "MT7620-ASIC"
	select USB_ARCH_HAS_OHCI
	select USB_ARCH_HAS_EHCI

endchoice

endif

#--------------------------

if RALINK_MT7621

choice
        prompt "Soc Hardware Type"
	default MT7621_ASIC

config  MT7621_ASIC 
	bool "MT7621-ASIC"

endchoice

endif
#--------------------------

if RALINK_MT7628

choice
        prompt "Soc Hardware Type"
	default MT7628_ASIC

config  MT7628_ASIC 
	bool "MT7628-ASIC"
	select USB_ARCH_HAS_OHCI
	select USB_ARCH_HAS_EHCI

endchoice

endif

#--------------------------
config FLASH_REMAP_NEED
       bool
       default y if (RALINK_RT2880)
choice
       prompt "DRAM Size"
       default RT2880_DRAM_16M

config RT2880_DRAM_8M
       bool "8M"

config RT2880_DRAM_16M
       bool "16M"

config RT2880_DRAM_32M
       bool "32M"

config RT2880_DRAM_64M
       bool "64M"

config RT2880_DRAM_128M
       bool "128M"

config RT2880_DRAM_256M
       bool "256M"

config RT2880_DRAM_512M
       bool "512M"
       depends on  RALINK_MT7621
       select HIGHMEM

endchoice


config  DUAL_IMAGE
	bool 'Dual Image' 

config  KERNEL_NVRAM
	bool 'Kernel NVRAM'
	default n

config  RALINK_TIMER
	tristate 'Ralink Hardware Timer0/Timer1' 

config  RALINK_TIMER_DFS
        bool "Ralink Timer0"
        depends on RALINK_TIMER

config  RALINK_TIMER_WDG
        tristate "WatchDog Timer"
        depends on RALINK_TIMER

config  RALINK_TIMER_WDG_RESET_OUTPUT
        bool "Ralink WatchDog Reset Output"
        depends on RALINK_TIMER_WDG

config  RALINK_WDG_TIMER
        int "WatchDog Timer (Unit:1Sec, Max=30Sec)"
        default 10
        depends on RALINK_TIMER_WDG

config  RALINK_WDG_REFRESH_INTERVAL
        int "WatchDog Refresh Interval (Unit:1Sec, Max=30Sec)"
        default 4
        depends on RALINK_TIMER_WDG

config  RALINK_CPUSLEEP
	bool "Ralink CPU Sleep mode"
	select RALINK_SYSTICK
	depends on RALINK_MT7620 || RALINK_MT7621 || RALINK_MT7628
	default n

config  RALINK_SYSTICK
	bool "Ralink System Tick Counter"
	depends on RALINK_MT7620 || RALINK_MT7621 || RALINK_MT7628
	select GENERIC_CLOCKEVENTS_BROADCAST if RALINK_MT7621
	default n
```

## arch/mips/trendchip/Kconfig
```kconfig
if MIPS_RT63365
config SOFTFLOAT_LIB
  bool "Compile softfloat library"
  help
  
config PCIE_CONCURENNCY
  bool "Enable 2 PCIe port"
  help
  
endif
```

## drivers/mtd/mtk/Kconfig
```kconfig
menu "Ralink Non-volatile Device Drivers"
	depends on MTD!=n

config MTD_NAND_MTK
	tristate "NAND Flash Support"
	depends on MIPS_RT63365
	select MTD_PARTITIONS
	help
	  support NAND flash controller.

endmenu
```

## drivers/mtd/ralink/Kconfig
```kconfig
menu "Ralink Non-volatile Device Drivers"
	depends on MTD!=n

config MTD_NAND_RALINK
	tristate "NAND Flash Support"
	select MTD_PARTITIONS
	help
	  support Ralink 3052 nand flash controller.

config MTD_SPI_RALINK
	tristate "SPI Flash Support"
	select MTD_PARTITIONS
	help
	  supoort Ralink 3052 serial spi controller with SPI flash.

config MTD_NOR_RALINK
	tristate "NOR Flash Support"
	select MTD_PARTITIONS
	depends on RALINK_RT3052
	help
	  supoort Ralink 3052  with NOR flash.

config RALINK_SLIC_CONNECT_SPI_CS1
	depends on MTD_SPI_RALINK
	bool "SLIC CS Pin Connects to SPI CS1"
	default n

config RALINK_SPI_CS1_HIGH_ACTIVE
	depends on RALINK_SLIC_CONNECT_SPI_CS1
	bool "SPI CS1(Chip Select) is high active"
	default n

endmenu
```

## drivers/net/wireless/mt7628_ap/Kconfig
```kconfig
config MT_AP_SUPPORT
	bool
	default y

config NEW_RATE_ADAPT_SUPPORT
	bool "New adaption rate"
	default y

config AGS_SUPPORT
	bool "AGS support"
	default n
	depends on NEW_RATE_ADAPT_SUPPORT

config MT_MAC
	bool
	default y

config UAPSD
	bool "Unscheduled automatic power save delivery"
	default n

config WSC_INCLUDED
	bool "WSC"
	default y

config WSC_V2_SUPPORT
	bool "WSC V2"
	depends on WSC_INCLUDED
	default y

config WMM_ACM_SUPPORT
	bool "WMM ACM"
	default n

config DOT11W_PMF_SUPPORT
	bool "802.11w PMF support"
	default y

config LLTD_SUPPORT
	bool "Link layer topology discovery"
	default n

config PASSPOINT_R2
	bool "Pass point R2"
	default n

config SNIFFER_SUPPORT
	bool "Sniffer support"
	default n

config IGMP_SNOOP_SUPPORT
	bool "IGMP snooping"
	default y

config BLOCK_NET_IF
	bool "Block a network interface while a TX queue is full"
	default n

config SINGLE_SKU
	bool "Single SKU V2"
	default n

config LED_CONTROL_SUPPORT
	bool "LED control"
	default y

config QOS_DLS_SUPPORT
	bool "QoS DLS"
	default n

config MBSS_SUPPORT
	bool "MBSS support"
	default y

config NEW_MBSSID_MODE
	bool "New MBSSID mode"
	default y
	depends on MBSS_SUPPORT

config ENHANCE_NEW_MBSSID_MODE
	bool "Enchance new MBSSID mode"
	default y
	depends on NEW_MBSSID_MODE

config APCLI_SUPPORT
	bool "ApCli support"
	default y

config MAC_REPEATER_SUPPORT
	bool "MAC repeater support"
	default n
	depends on APCLI_SUPPORT

config IDS_SUPPORT
	bool "Intrusion detection system"
	default n

config ATE_SUPPORT
	bool "ATE support"
	default n

config WIFI_DEBUG_SUPPORT
	bool "Debug mode support"
	default n

config RTMP_FLASH_SUPPORT
	bool "RTMP flash support"
	default y

config RTMP_TEMPERATURE_TX_ALC
	bool "Temperature TX ALC"
	default n

config RTMP_INTERNAL_TX_ALC
	bool "Internal TX ALC"
	default n
```

## drivers/net/wireless/mt76x2/Kconfig
```kconfig
config WIFI_BASIC_FUNC
	bool "Basic functions"
	select WIRELESS_EXT
	select WEXT_SPY
	select WEXT_PRIV

config WSC_INCLUDED
	bool "WSC (Wi-Fi simple configuration)"
	depends on WIFI_DRIVER
	default y

config WSC_V2_SUPPORT
	bool "WSC V2 (Wi-Fi simple configuration version 2.0)"
	depends on WIFI_DRIVER
	default y

config DOT11N_DRAFT3
	bool "802.11n Draft3"
	depends on WIFI_DRIVER
	default n

config DOT11_VHT_AC
	bool "802.11ac"
	depends on WIFI_DRIVER
	default n

config DOT11W_PMF_SUPPORT
	bool "PMF support"
	depends on WIFI_DRIVER
	default n

config TXBF_SUPPORT
	bool "TX bean forming support"
	depends on WIFI_DRIVER
	default n

config WMM_ACM_SUPPORT
	bool "WMM ACM"
	depends on WIFI_DRIVER
	default n

config LLTD_SUPPORT
	bool "LLTD (link layer topology discovery protocol)"
	depends on WIFI_DRIVER
	default n

config QOS_DLS_SUPPORT
	bool "802.11e DLS (direct-link setup) support"
	depends on WIFI_DRIVER
	default n

config WAPI_SUPPORT
	bool "WAPI support"
	depends on WIFI_DRIVER
	default n

config CARRIER_DETECTION_SUPPORT
	bool "Carrier detection"
	depends on WIFI_DRIVER
	default n

config ED_MONITOR_SUPPORT
	bool "ED CCA monitor support"
	depends on WIFI_DRIVER
	default n

config IGMP_SNOOP_SUPPORT
	bool "IGMP snooping"
	depends on WIFI_DRIVER
	default y

config BLOCK_NET_IF
	bool "NETIF block"
	depends on WIFI_DRIVER
	default n

config VIDEO_TURBINE_SUPPORT
	bool "Video turbine support"
	depends on WIFI_DRIVER
	default n

config RATE_ADAPTION
	bool "New rate adaptation support"
	depends on WIFI_DRIVER
	default n

config NEW_RATE_ADAPT_SUPPORT
	bool "Intelligent rate adaption"
	depends on RATE_ADAPTION
	depends on WIFI_DRIVER
	default y

config AGS_SUPPORT
	bool "Adaptive group switching"
	depends on RATE_ADAPTION
	depends on WIFI_DRIVER
	default n

config IDS_SUPPORT
	bool "IDS (intrusion detection system) support"
	depends on WIFI_DRIVER
	default n

config WIFI_WORK_QUEUE
	bool "Work queue"
	depends on WIFI_DRIVER
	default n

config RTMP_FLASH_SUPPORT
	bool "Flash support"
	depends on WIFI_DRIVER
	default n

config LED_CONTROL_SUPPORT
	bool "LED control support"
	depends on WIFI_DRIVER
	default y

config SINGLE_SKU_V2
	bool "Single SKU V2"
	depends on WIFI_DRIVER
	default n

config ATE_SUPPORT
	bool "ATE/QA support"
	depends on WIFI_DRIVER
	default n

config WIFI_DEBUG_SUPPORT
	bool "Debug mode support"
	depends on WIFI_DRIVER
	default n

config AP_32B_DESC
	bool "32 byte descriptor support"
	depends on WIFI_DRIVER
	default n

config RTMP_INTERNAL_TX_ALC
	bool "TSSI compensation"
	depends on WIFI_DRIVER
	depends on RALINK_RT6352
	default n

config HOTSPOT
	bool "Passpoint-R1 support"
	depends on WIFI_DRIVER
	default n

config COC_SUPPORT
	bool "Co-clock support"
	depends on WIFI_DRIVER
	default n

menu "PA/LNA settings of 1st card"
	config FIRST_CARD_EXTERNAL_PA
		bool "External power amplifier (PA)"
		depends on WIFI_DRIVER
		default n

	config FIRST_CARD_EXTERNAL_LNA
		bool "External low-noise amplifier (LNA)"
		depends on WIFI_DRIVER
		default n
endmenu

menu "PA/LNA settings of 2nd card"
	config SECOND_CARD_EXTERNAL_PA
		bool "External power amplifier (PA)"
		depends on WIFI_DRIVER
		default n

	config SECOND_CARD_EXTERNAL_LNA
		bool "External low-noise amplifier (LNA)"
		depends on WIFI_DRIVER
		default n
endmenu
```

## drivers/net/wireless/mt76x2_ap/Kconfig
```kconfig
config RLT_AP_SUPPORT
	tristate "MediaTek RLT Wi-Fi AP support"
	select WIRELESS_EXT
	select WEXT_SPY
	select WEXT_PRIV

config WDS_SUPPORT
	bool "WDS"
	depends on RLT_AP_SUPPORT
	default n

config MBSS_SUPPORT
	bool "MBSSID"
	depends on RLT_AP_SUPPORT
	default y

config NEW_MBSSID_MODE
	bool "New MBSSID mode"
	depends on RLT_AP_SUPPORT
	depends on MBSS_SUPPORT
	default n

config ENHANCE_NEW_MBSSID_MODE
	bool "Enhanced MBSSID mode"
	depends on NEW_MBSSID_MODE
	default n

config APCLI_SUPPORT
	bool "AP-Client support"
	depends on RLT_AP_SUPPORT
	default y

config APCLI_CERT_SUPPORT
	bool "AP-Client TGn cert support"
	depends on RLT_AP_SUPPORT
	depends on APCLI_SUPPORT
	default n

config MAC_REPEATER_SUPPORT
	bool "MAC repeater support"
	depends on RLT_AP_SUPPORT
	depends on APCLI_SUPPORT
	default n

config DFS_SUPPORT
	bool "DFS support"
	depends on RLT_AP_SUPPORT
	select RALINK_TIMER_DFS
	default n

config NINTENDO_AP
	bool "Nintendo AP support"
	depends on RLT_AP_SUPPORT
	default n

config DELAYED_TCP_ACK_SUPPORT
	bool "Delayed TCP ACK support"
	depends on RLT_AP_SUPPORT
	default n

config MCAST_RATE_SPECIFIC
	bool "User specific TX rate of multicast packets"
	depends on RLT_AP_SUPPORT
	default n

config EXT_BUILD_CHANNEL_LIST
	bool "Channel list extension"
	depends on RLT_AP_SUPPORT
	default n
```

## drivers/net/wireless/rt3592_ap/Kconfig
```kconfig
config RT3593_AP
	tristate "Ralink RT5392 802.11n AP support"
	select WIRELESS_EXT
	select WEXT_SPY
	select WEXT_PRIV

config  RT3593_AP_LED
	bool "LED Support"
	depends on RT3593_AP

config  RT3593_AP_WSC
	bool "WSC (WiFi Simple Config)"
	depends on RT3593_AP

config  RT3593_AP_WSC_V2
	bool "WSC V2 (WiFi Simple Config Version 2)"
	default n
	depends on RT3593_AP_WSC

config  RT3593_AP_LLTD
	bool "LLTD (Link Layer Topology Discovery Protocol)"
	depends on RT3593_AP

config  RT3593_AP_WDS
	bool "WDS"
	depends on RT3593_AP

config  RT3593_AP_MBSS
	bool "MBSSID"
	depends on RT3593_AP

config  RT3593_AP_MBSS_NEW_MBSSID_MODE
	bool "New MBSSID mode support"
	default n
	depends on RT3593_AP_MBSS

config  RT3593_AP_APCLI
	bool "AP-CLient Support"
	depends on RT3593_AP

config  RT3593_AP_IGMP_SNOOP
	bool "IGMP snooping"
	depends on RT3593_AP

config  RT3593_AP_NETIF_BLOCK
	bool "NETIF Block"
	depends on RT3593_AP
	help
	Support Net interface block while Tx-Sw queue full

config  RT3593_AP_DFS
	bool "DFS"
	depends on RT3593_AP
	select RALINK_TIMER_DFS

config  RT3593_AP_CARRIER
	bool "Carrier Detect"
	depends on RT3593_AP

config  RT3593_AP_VIDEO_TURBINE
	bool "Video Turbine support"
	depends on RT3593_AP

config  RT3593_AP_DLS
	bool "DLS (Direct-Link Setup) Support"
	depends on RT3593_AP

config  RT3593_AP_IDS
	bool "IDS (Intrusion Detection System) Support"
	depends on RT3593_AP

config  RT3593_AP_GREENAP
	bool "Green AP mode support"
	depends on RT3593_AP

config  RT3593_AP_80211N_DRAFT3
	bool "802.11n Draft3"
	depends on RT3593_AP

config  RT3593_AP_SINGLE_SKU
	bool "Single SKU"
	default n
	depends on RT3593_AP

config  RT3593_AP_ATE
	bool "Provide ATE testmode commands support"
	default n
	depends on RT3593_AP

config  RT3593_AP_QA
	bool "Provide QA tool support"
	default n
	depends on RT3593_AP
	depends on RT3593_AP_ATE

config  RT3593_AP_DBG
	bool "Debug support for AP mode"
	default n
	depends on RT3593_AP
```
