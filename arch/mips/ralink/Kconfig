## drivers/net/wireless/rt539x/Kconfig
```kconfig
#
menuconfig RT539X
	tristate "Ralink RT539X/559X Wi-Fi driver"

if RT539X

config RT539X_AP_24G
	tristate "Wi-Fi Ralink RT539X driver for 2.4 GHz AP"

config RT539X_AP_5G
	tristate "Wi-Fi Ralink RT539X driver for 5 GHz AP"

config RT539X_CHIPSET_5390
	bool "Has chipset 5390"
	depends on RT539X_AP_5G || RT539X_AP_24G

config RT539X_24G_CHIPSET_5390
	bool "Has chipset 5390 for 2.4 GHz AP"
	depends on RT539X_AP_5G || RT539X_AP_24G

config RT539X_CHIPSET_3593
	bool "Has chipset 3593"
	depends on RT539X_AP_5G || RT539X_AP_24G

config RT539X_5G_CHIPSET_3593
	bool "Has chipset 3593 for 5 GHz AP"
	depends on RT539X_AP_5G || RT539X_AP_24G

config RT539X_CHIPSET_5592
	bool "Has chipset 5592"
	depends on RT539X_AP_5G || RT539X_AP_24G

config RT539X_AP_MBSS
	bool "RT539X_AP_MBSS"
	depends on RT539X_AP_5G || RT539X_AP_24G

config RT539X_24G_AP_MBSS
	bool "RT539X_AP_MBSS for 2.4 GHz AP"
	depends on RT539X_AP_5G || RT539X_AP_24G

config RT539X_AP_MBSS_NEW
	bool "RT539X_AP_MBSS_NEW"
	depends on RT539X_AP_5G || RT539X_AP_24G

config RT539X_24G_AP_MBSS_NEW
	bool "RT539X_AP_MBSS_NEW for 2.4 GHz AP"
	depends on RT539X_AP_5G || RT539X_AP_24G

config RT539X_HAS_ANDROID_SUPPORT
	bool "RT539X_HAS_ANDROID_SUPPORT"
	depends on RT539X_AP_5G || RT539X_AP_24G

config RT539X_HAS_ANTENNA_DIVERSITY_SUPPORT
	bool "RT539X_HAS_ANTENNA_DIVERSITY_SUPPORT"
	depends on RT539X_AP_5G || RT539X_AP_24G

config RT539X_HAS_APCLI
	bool "RT539X_HAS_APCLI"
	depends on RT539X_AP_5G || RT539X_AP_24G

config RT539X_HAS_APCLI_WPA_SUPPLICANT
	bool "RT539X_HAS_APCLI_WPA_SUPPLICANT"
	depends on RT539X_AP_5G || RT539X_AP_24G

config RT539X_HAS_ATE
	bool "RT539X_HAS_ATE"
	depends on RT539X_AP_5G || RT539X_AP_24G

config RT539X_HAS_AUTO_CH_SELECT_ENHANCE
	bool "RT539X_HAS_AUTO_CH_SELECT_ENHANCE"
	depends on RT539X_AP_5G || RT539X_AP_24G

config RT539X_HAS_BGFP_OPEN_SUPPORT
	bool "RT539X_HAS_BGFP_OPEN_SUPPORT"
	depends on RT539X_AP_5G || RT539X_AP_24G

config RT539X_HAS_BGFP_SUPPORT
	bool "RT539X_HAS_BGFP_SUPPORT"
	depends on RT539X_AP_5G || RT539X_AP_24G

config RT539X_HAS_BLOCK_NET_IF
	bool "RT539X_HAS_BLOCK_NET_IF"
	depends on RT539X_AP_5G || RT539X_AP_24G

config RT539X_HAS_CFG80211_SUPPORT
	bool "RT539X_HAS_CFG80211_SUPPORT"
	depends on RT539X_AP_5G || RT539X_AP_24G

config RT539X_HAS_CLIENT_WDS_SUPPORT
	bool "RT539X_HAS_CLIENT_WDS_SUPPORT"
	depends on RT539X_AP_5G || RT539X_AP_24G

config RT539X_HAS_CS_SUPPORT
	bool "RT539X_HAS_CS_SUPPORT"
	depends on RT539X_AP_5G || RT539X_AP_24G

config RT539X_HAS_DFS_SUPPORT
	bool "RT539X_HAS_DFS_SUPPORT"
	depends on RT539X_AP_5G || RT539X_AP_24G

config RT539X_HAS_DOT11N_DRAFT3_SUPPORT
	bool "RT539X_HAS_DOT11N_DRAFT3_SUPPORT"
	depends on RT539X_AP_5G || RT539X_AP_24G

config RT539X_HAS_DOT11_N_SUPPORT
	bool "RT539X_HAS_DOT11_N_SUPPORT"
	depends on RT539X_AP_5G || RT539X_AP_24G

config RT539X_HAS_ETH_CONVERT_SUPPORT
	bool "RT539X_HAS_ETH_CONVERT_SUPPORT"
	depends on RT539X_AP_5G || RT539X_AP_24G

config RT539X_HAS_EXT_BUILD_CHANNEL_LIST
	bool "RT539X_HAS_EXT_BUILD_CHANNEL_LIST"
	depends on RT539X_AP_5G || RT539X_AP_24G

config RT539X_HAS_FIXUP_MAC
	bool "RT539X_HAS_FIXUP_MAC"
	depends on RT539X_AP_5G || RT539X_AP_24G

config RT539X_HAS_FOR_NDMS_V1
	bool "RT539X_HAS_FOR_NDMS_V1"
	depends on RT539X_AP_5G || RT539X_AP_24G

config RT539X_HAS_GREENAP_SUPPORT
	bool "RT539X_HAS_GREENAP_SUPPORT"
	depends on RT539X_AP_5G || RT539X_AP_24G

config RT539X_HAS_HOSTAPD_SUPPORT
	bool "RT539X_HAS_HOSTAPD_SUPPORT"
	depends on RT539X_AP_5G || RT539X_AP_24G

config RT539X_HAS_IDS_SUPPORT
	bool "RT539X_HAS_IDS_SUPPORT"
	depends on RT539X_AP_5G || RT539X_AP_24G

config RT539X_HAS_IFUP_IN_PROBE_SUPPORT
	bool "RT539X_HAS_IFUP_IN_PROBE_SUPPORT"
	depends on RT539X_AP_5G || RT539X_AP_24G

config RT539X_HAS_IGMP_SNOOP_SUPPORT
	bool "RT539X_HAS_IGMP_SNOOP_SUPPORT"
	depends on RT539X_AP_5G || RT539X_AP_24G

config RT539X_HAS_KTHREAD_SUPPORT
	bool "RT539X_HAS_KTHREAD_SUPPORT"
	depends on RT539X_AP_5G || RT539X_AP_24G

config RT539X_HAS_LED_CONTROL_SUPPORT
	bool "RT539X_HAS_LED_CONTROL_SUPPORT"
	depends on RT539X_AP_5G || RT539X_AP_24G

config RT539X_HAS_LLTD
	bool "RT539X_HAS_LLTD"
	depends on RT539X_AP_5G || RT539X_AP_24G

config RT539X_HAS_MCAST_RATE_SPECIFIC_SUPPORT
	bool "RT539X_HAS_MCAST_RATE_SPECIFIC_SUPPORT"
	depends on RT539X_AP_5G || RT539X_AP_24G

config RT539X_HAS_MC_SUPPORT
	bool "RT539X_HAS_MC_SUPPORT"
	depends on RT539X_AP_5G || RT539X_AP_24G

config RT539X_HAS_MICROWAVE_OVEN_SUPPORT
	bool "RT539X_HAS_MICROWAVE_OVEN_SUPPORT"
	depends on RT539X_AP_5G || RT539X_AP_24G

config RT539X_HAS_MSI_SUPPORT
	bool "RT539X_HAS_MSI_SUPPORT"
	depends on RT539X_AP_5G || RT539X_AP_24G

config RT539X_HAS_NEW_RATE_ADAPT_SUPPORT
	bool "RT539X_HAS_NEW_RATE_ADAPT_SUPPORT"
	depends on RT539X_AP_5G || RT539X_AP_24G

config RT539X_HAS_NEW_TXCONT
	bool "RT539X_HAS_NEW_TXCONT"
	depends on RT539X_AP_5G || RT539X_AP_24G

config RT539X_HAS_OSABL_FUNC_SUPPORT
	bool "RT539X_HAS_OSABL_FUNC_SUPPORT"
	depends on RT539X_AP_5G || RT539X_AP_24G

config RT539X_HAS_OSABL_OS_AP_SUPPORT
	bool "RT539X_HAS_OSABL_OS_AP_SUPPORT"
	depends on RT539X_AP_5G || RT539X_AP_24G

config RT539X_HAS_OSABL_OS_PCI_SUPPORT
	bool "RT539X_HAS_OSABL_OS_PCI_SUPPORT"
	depends on RT539X_AP_5G || RT539X_AP_24G

config RT539X_HAS_OSABL_OS_RBUS_SUPPORT
	bool "RT539X_HAS_OSABL_OS_RBUS_SUPPORT"
	depends on RT539X_AP_5G || RT539X_AP_24G

config RT539X_HAS_OSABL_OS_STA_SUPPORT
	bool "RT539X_HAS_OSABL_OS_STA_SUPPORT"
	depends on RT539X_AP_5G || RT539X_AP_24G

config RT539X_HAS_OSABL_OS_USB_SUPPORT
	bool "RT539X_HAS_OSABL_OS_USB_SUPPORT"
	depends on RT539X_AP_5G || RT539X_AP_24G

config RT539X_HAS_QA_SUPPORT
	bool "RT539X_HAS_QA_SUPPORT"
	depends on RT539X_AP_5G || RT539X_AP_24G

config RT539X_HAS_QOS_DLS_SUPPORT
	bool "RT539X_HAS_QOS_DLS_SUPPORT"
	depends on RT539X_AP_5G || RT539X_AP_24G

config RT539X_HAS_RA_HW_NAT
	bool "RT539X_HAS_RA_HW_NAT"
	depends on RT539X_AP_5G || RT539X_AP_24G

config RT539X_HAS_RESOURCE_PRE_ALLOC
	bool "RT539X_HAS_RESOURCE_PRE_ALLOC"
	depends on RT539X_AP_5G || RT539X_AP_24G

config RT539X_HAS_RFKILL_HW_SUPPORT
	bool "RT539X_HAS_RFKILL_HW_SUPPORT"
	depends on RT539X_AP_5G || RT539X_AP_24G

config RT539X_HAS_RSSI_FEEDBACK
	bool "RT539X_HAS_RSSI_FEEDBACK"
	depends on RT539X_AP_5G || RT539X_AP_24G

config RT539X_HAS_RT2880_RT2860_COEXIST
	bool "RT539X_HAS_RT2880_RT2860_COEXIST"
	depends on RT539X_AP_5G || RT539X_AP_24G

config RT539X_HAS_RTMP_FLASH_SUPPORT
	bool "RT539X_HAS_RTMP_FLASH_SUPPORT"
	depends on RT539X_AP_5G || RT539X_AP_24G

config RT539X_HAS_SINGLE_SKU_SUPPORT
	bool "RT539X_HAS_SINGLE_SKU_SUPPORT"
	depends on RT539X_AP_5G || RT539X_AP_24G

config RT539X_HAS_SNMP_SUPPORT
	bool "RT539X_HAS_SNMP_SUPPORT"
	depends on RT539X_AP_5G || RT539X_AP_24G

config RT539X_HAS_STATS_COUNT
	bool "RT539X_HAS_STATS_COUNT"
	depends on RT539X_AP_5G || RT539X_AP_24G

config RT539X_HAS_STREAM_MODE_SUPPORT
	bool "RT539X_HAS_STREAM_MODE_SUPPORT"
	depends on RT539X_AP_5G || RT539X_AP_24G

config RT539X_5G_HAS_STREAM_MODE_SUPPORT
	bool "RT539X_HAS_STREAM_MODE_SUPPORT for 5 GHz AP"
	depends on RT539X_AP_5G || RT539X_AP_24G

config RT539X_HAS_TSO_SUPPORT
	bool "RT539X_HAS_TSO_SUPPORT"
	depends on RT539X_AP_5G || RT539X_AP_24G

config RT539X_HAS_TSSI_ANTENNA_VARIATION
	bool "RT539X_HAS_TSSI_ANTENNA_VARIATION"
	depends on RT539X_AP_5G || RT539X_AP_24G

config RT539X_HAS_TXBF_SUPPORT
	bool "RT539X_HAS_TXBF_SUPPORT"
	depends on RT539X_AP_5G || RT539X_AP_24G

config RT539X_HAS_TXRX_SW_ANTDIV_SUPPORT
	bool "RT539X_HAS_TXRX_SW_ANTDIV_SUPPORT"
	depends on RT539X_AP_5G || RT539X_AP_24G

config RT539X_HAS_USB_BULK_BUF_ALIGMENT
	bool "RT539X_HAS_USB_BULK_BUF_ALIGMENT"
	depends on RT539X_AP_5G || RT539X_AP_24G

config RT539X_HAS_USB_FIRMWARE_MULTIBYTE_WRITE
	bool "RT539X_HAS_USB_FIRMWARE_MULTIBYTE_WRITE"
	depends on RT539X_AP_5G || RT539X_AP_24G

config RT539X_HAS_USB_SUPPORT_SELECTIVE_SUSPEND
	bool "RT539X_HAS_USB_SUPPORT_SELECTIVE_SUSPEND"
	depends on RT539X_AP_5G || RT539X_AP_24G

config RT539X_HAS_WAPI_SUPPORT
	bool "RT539X_HAS_WAPI_SUPPORT"
	depends on RT539X_AP_5G || RT539X_AP_24G

config RT539X_HAS_WDS
	bool "RT539X_HAS_WDS"
	depends on RT539X_AP_5G || RT539X_AP_24G

config RT539X_HAS_WMM_ACM_SUPPORT
	bool "RT539X_HAS_WMM_ACM_SUPPORT"
	depends on RT539X_AP_5G || RT539X_AP_24G

config RT539X_HAS_WOW_IFDOWN_SUPPORT
	bool "RT539X_HAS_WOW_IFDOWN_SUPPORT"
	depends on RT539X_AP_5G || RT539X_AP_24G

config RT539X_HAS_WOW_SUPPORT
	bool "RT539X_HAS_WOW_SUPPORT"
	depends on RT539X_AP_5G || RT539X_AP_24G

config RT539X_HAS_WSC
	bool "RT539X_HAS_WSC"
	depends on RT539X_AP_5G || RT539X_AP_24G

config RT539X_HAS_WSC_LED
	bool "RT539X_HAS_WSC_LED"
	depends on RT539X_AP_5G || RT539X_AP_24G

config RT539X_HAS_WSC_V2
	bool "RT539X_HAS_WSC_V2"
	depends on RT539X_AP_5G || RT539X_AP_24G

config RT539X_HAS_XLINK
	bool "RT539X_HAS_XLINK"
	depends on RT539X_AP_5G || RT539X_AP_24G

config RT539X_MBSS_SUPPORT
	bool "RT539X_MBSS_SUPPORT"
	depends on RT539X_AP_5G || RT539X_AP_24G

endif
```

## vendors/Kconfig
```kconfig
# Add new vendor config

source "vendors/Kconfig.ralink"

source "vendors/Kconfig.atel"

source "vendors/Kconfig.mt"
```

## vendors/Kconfig.atel
```kconfig
menu "Atel modules"

config USBNET_ATEL_LTE
        tristate "Atel LTE CDC USB modem driver"
        depends on USB_USBNET
		default m

config USBNET_ATEL_LTE_SERVICE
        tristate "Service/debug module for Atel LTE modem"
        depends on USBNET_ATEL_LTE
		default n

endmenu
```

## vendors/Kconfig.econet
```kconfig
menu "Trendchip TCSUPPORT options"

config TCSUPPORT_CT
	bool "TCSUPPORT_CT"

config TCSUPPORT_MT7510_E1
	bool "TCSUPPORT_MT7510_E1"

config TCSUPPORT_MT7510_FE
	bool "TCSUPPORT_MT7510_FE"

config TCSUPPORT_CPU_MT7510
	bool "TCSUPPORT_CPU_MT7510"

config TCSUPPORT_CPU_MT7520
	bool "TCSUPPORT_CPU_MT7510"

config TCSUPPORT_CPU_MT752025
	bool "TCSUPPORT_CPU_MT752025"

config TCSUPPORT_MT7520_PCIE
	bool "TCSUPPORT_MT7520_PCIE"

config TCSUPPORT_CPU_RT65168
	bool "TCSUPPORT_CPU_RT65168"

config TCSUPPORT_CPU_TC3182
	bool "TCSUPPORT_CPU_TC3182"

config TCSUPPORT_TC2031
	bool "TCSUPPORT_TC2031"

config TCSUPPORT_MEMORY_CONTROL
	bool "TCSUPPORT_MEMORY_CONTROL"

config TCSUPPORT_OOM_RB_NEXT
	bool "TCSUPPORT_OOM_RB_NEXT"

config TCSUPPORT_FREE_BOOTBASE
	bool "TCSUPPORT_FREE_BOOTBASE"

config TCSUPPORT_ADDR_MAPPING
	bool "TCSUPPORT_ADDR_MAPPING"

config TCSUPPORT_DYING_GASP
	bool "TCSUPPORT_DYING_GASP"

config TCSUPPORT_POWERSAVE_ENABLE
	bool "TCSUPPORT_POWERSAVE_ENABLE"

config TCSUPPORT_GPIO_ECM
	bool "TCSUPPORT_GPIO_ECM"

config TCSUPPORT_SUPPORT_FLASH
	bool "TCSUPPORT_SUPPORT_FLASH"

config TCSUPPORT_NAND_FLASH
	bool "TCSUPPORT_NAND_FLASH"

config TCSUPPORT_NAND_BMT
	bool "TCSUPPORT_NAND_BMT"

config TCSUPPORT_YAFFS_FS
	bool "TCSUPPORT_YAFFS_FS"

config TCSUPPORT_FW_UPGRADE_16M
	bool "TCSUPPORT_FW_UPGRADE_16M"

config TCSUPPORT_DUAL_IMAGE_ENHANCE
	bool "TCSUPPORT_DUAL_IMAGE_ENHANCE"

config TCSUPPORT_MTD_ENCHANCEMENT
	bool "TCSUPPORT_MTD_ENCHANCEMENT"

config TCSUPPORT_RESERVEAREA_1_BLOCK
	bool "TCSUPPORT_RESERVEAREA_1_BLOCK"

config TCSUPPORT_RESERVEAREA_2_BLOCK
	bool "TCSUPPORT_RESERVEAREA_2_BLOCK"

config TCSUPPORT_RESERVEAREA_3_BLOCK
	bool "TCSUPPORT_RESERVEAREA_3_BLOCK"

config TCSUPPORT_RESERVEAREA_BLOCK
	bool "TCSUPPORT_RESERVEAREA_BLOCK"

config TCSUPPORT_MULTI_BOOT
	bool "TCSUPPORT_MULTI_BOOT"

config TCSUPPORT_NAND_BADBLOCK_CHECK
	bool "TCSUPPORT_NAND_BADBLOCK_CHECK"

config TCSUPPORT_SQUASHFS_ADD_YAFFS
	bool "TCSUPPORT_SQUASHFS_ADD_YAFFS"

config TCSUPPORT_BOOTROM_LARGE_SIZE
	bool "TCSUPPORT_BOOTROM_LARGE_SIZE"

config TCSUPPORT_NAND_RT63368
	bool "TCSUPPORT_NAND_RT63368"

config TCSUPPORT_NAND_BADBLOCK_CHECK
	bool "TCSUPPORT_NAND_BADBLOCK_CHECK"

config TCSUPPORT_USB_HOST_LED
	bool "TCSUPPORT_USB_HOST_LED"

config TCSUPPORT_BONDING
	bool "TCSUPPORT_BONDING"

config TCSUPPORT_PORTBIND
	bool "TCSUPPORT_PORTBIND"

config TCSUPPORT_CWMP_VDSL
	bool "TCSUPPORT_CWMP_VDSL"

config TCSUPPORT_VOIP
	bool "TCSUPPORT_VOIP"

config TCSUPPORT_DUAL_WLAN
	bool "TCSUPPORT_DUAL_WLAN"

config TCSUPPORT_HWNAT
	bool "TCSUPPORT_HWNAT"

config TCSUPPORT_RA_HWNAT
	bool "TCSUPPORT_RA_HWNAT"

config TCSUPPORT_RA_HWNAT_ENHANCE_HOOK
	bool "TCSUPPORT_RA_HWNAT_ENHANCE_HOOK"

config TCSUPPORT_IGMPSNOOPING_ENHANCE
	bool "TCSUPPORT_IGMPSNOOPING_ENHANCE"

config TCSUPPORT_VLAN_TAG
	bool "TCSUPPORT_VLAN_TAG"

config TCSUPPORT_PON_VLAN
	bool "TCSUPPORT_PON_VLAN"

config TCSUPPORT_WAN_GPON
	bool "TCSUPPORT_WAN_GPON"

config TCSUPPORT_WAN_EPON
	bool "TCSUPPORT_WAN_EPON"

config TCSUPPORT_EPON_MAPPING
	bool "TCSUPPORT_EPON_MAPPING"

config TCSUPPORT_GPON_MAPPING
	bool "TCSUPPORT_GPON_MAPPING"

config TCSUPPORT_GPON_DOWNSTREAM_MAPPING
	bool "TCSUPPORT_GPON_DOWNSTREAM_MAPPING"

config TCSUPPORT_PON_USER_ISOLATION
	bool "TCSUPPORT_PON_USER_ISOLATION"

config TCSUPPORT_PON_MAC_FILTER
	bool "TCSUPPORT_PON_MAC_FILTER"

config TCSUPPORT_WAN_ETHER
	bool "TCSUPPORT_WAN_ETHER"

config TCSUPPORT_WAN_PTM
	bool "TCSUPPORT_WAN_PTM"

config TCSUPPORT_CT_VLAN_TAG
	bool "TCSUPPORT_CT_VLAN_TAG"

config TCSUPPORT_QOS
	bool "TCSUPPORT_QOS"

config TCSUPPORT_DOWNSTREAM_QOS
	bool "TCSUPPORT_DOWNSTREAM_QOS"

config TCSUPPORT_IGMP_QOS
	bool "TCSUPPORT_IGMP_QOS"

config TCSUPPORT_IPV6_ENHANCEMENT
	bool "TCSUPPORT_IPV6_ENHANCEMENT"

config TCSUPPORT_IPV6_ADVANCE
	bool "TCSUPPORT_IPV6_ADVANCE"

config TCSUPPORT_BRIDGE_FASTPATH
	bool "TCSUPPORT_BRIDGE_FASTPATH"

config TCSUPPORT_IPSEC_PASSTHROUGH
	bool "TCSUPPORT_IPSEC_PASSTHROUGH"

config TCSUPPORT_FTP_THROUGHPUT
	bool "TCSUPPORT_FTP_THROUGHPUT"

config TCSUPPORT_SBTHROUGHPUT_ENHANCE
	bool "TCSUPPORT_SBTHROUGHPUT_ENHANCE"

config TCSUPPORT_MULTISERVICE_ON_WAN
	bool "TCSUPPORT_MULTISERVICE_ON_WAN"

config TCSUPPORT_CT_DNSBIND
	bool "TCSUPPORT_CT_DNSBIND"

config TCSUPPORT_HW_CRYPTO
	bool "TCSUPPORT_HW_CRYPTO"

config CONFIG_VPN_PASSTHROUGH_INFO
	bool "CONFIG_VPN_PASSTHROUGH_INFO"

config TCSUPPORT_REDIRECT_PORTMASK
	bool "TCSUPPORT_REDIRECT_PORTMASK"

config TCSUPPORT_REDIRECT_WITH_PORTMASK
	bool "TCSUPPORT_REDIRECT_WITH_PORTMASK"

config TCSUPPORT_PORT_TRIGGER
	bool "TCSUPPORT_PORT_TRIGGER"

config TCSUPPORT_ACCOUNT_ACL
	bool "TCSUPPORT_ACCOUNT_ACL"

config TCSUPPORT_CD_NEW_GUI
	bool "TCSUPPORT_CD_NEW_GUI"

config TCSUPPORT_CT_E8GUI
	bool "TCSUPPORT_CT_E8GUI"


endmenu
```
